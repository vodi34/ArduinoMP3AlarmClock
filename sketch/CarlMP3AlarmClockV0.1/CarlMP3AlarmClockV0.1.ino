#include <Adafruit_GFX.h>    // Core graphics library
#include <MCUFRIEND_kbv.h>   // Hardware-specific library
MCUFRIEND_kbv tft;

/* 
 *  Tutorial für tft
 *  https://learn.adafruit.com/adafruit-gfx-graphics-library/graphics-primitives
 */

#include <Fonts/FreeSans9pt7b.h>
#include <Fonts/FreeSans12pt7b.h>
#include <Fonts/FreeSerif12pt7b.h>
#include <FreeDefaultFonts.h>

#define BLACK   0x0000
#define RED     0xF800
#define GREEN   0x07E0
#define WHITE   0xFFFF
#define GREY    0x8410

// 'play', 50x50
// created with : http://javl.github.io/image2cpp/
// dont forget to invert image colors
//
const uint8_t PlayButton[] PROGMEM = {
// 'play', 50x50px
0x00, 0x00, 0x00, 0x00, 0x00, 0x00, 0x00, 0x00, 0x00, 0x3f, 0xff, 0x00, 0x00, 0x00, 0x00, 0x00, 
0xff, 0xff, 0xc0, 0x00, 0x00, 0x00, 0x07, 0xc0, 0x00, 0xf8, 0x00, 0x00, 0x00, 0x0f, 0x00, 0x00, 
0x1c, 0x00, 0x00, 0x00, 0x3c, 0x00, 0x00, 0x0f, 0x00, 0x00, 0x00, 0x70, 0x00, 0x00, 0x03, 0x80, 
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0x00, 0x00, 0x3f, 0xff, 0x00, 0x00, 0x00, 0x00, 0x00, 0x00, 0xc0, 0x00, 0x00, 0x00
};

// 'play', 50x50
// created with : http://javl.github.io/image2cpp/
// dont forget to invert image colors
//
const uint8_t AlarmButton[] PROGMEM = {
// 'alarm', 50x50px
0x00, 0x00, 0x00, 0x00, 0x00, 0x00, 0x00, 0x00, 0x00, 0x00, 0x00, 0x00, 0x00, 0x00, 0x00, 0x00, 
0x00, 0x00, 0x00, 0x00, 0x00, 0x00, 0x00, 0x00, 0x00, 0x00, 0x00, 0x00, 0x00, 0x00, 0x00, 0x00, 
0x00, 0x00, 0x00, 0x00, 0x00, 0x00, 0x00, 0x00, 0x00, 0x00, 0x00, 0x00, 0x00, 0x00, 0x00, 0x00, 
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0x00, 0x00, 0x00, 0x00, 0x00, 0x00, 0x00, 0x00, 0x00, 0x00, 0x00, 0x00, 0x00, 0x00
};


//RTC
    int h = 16;
    int m = 16;
    int s = 38;
    int t = 12; // Temp
   
    String H="", M="", S="", T = "", D="08.03.2020";
    boolean h_skip, m_skip, d_skip;
    
void setup(void)
{
    Serial.begin(9600);
    
    uint16_t ID = tft.readID();
    Serial.println("starting Carl's MP3 Alarm Clock");
    Serial.print("found TFT.ID = 0x");
    Serial.println(ID, HEX);
    
    if (ID == 0xD3D3) ID = 0x9481; //force ID if write-only display
    tft.begin(ID);
    tft.setRotation(3); 
    Serial.println( "TFT.setRotation: 3");

    
    Serial.println( "TFT.setFont: FreeSevenSegNumFont" );
    tft.setFont(&FreeSevenSegNumFont);
    tft.setTextColor(BLACK);  
    tft.fillScreen(WHITE); // löscht den Screen komplett

    buildTimeStrings();
    showmsgXY(140, 180, 1, H );
    showmsgXY(220, 180, 1, M );
    showmsgXY(300, 180, 1, S );
    showTemperature();
    showDate();

    tft.setFont(&FreeSans9pt7b);
    showmsgXY( 8, 300, 1, "MP3 Alarm Clock V0.1 (c) Carl Dietzel 2020" );

    tft.drawBitmap( 180,190, PlayButton, 50,50, BLACK);
    tft.drawBitmap( 240,190, AlarmButton, 50,50, BLACK);

  
}


void loop(void)
{
    
    s++; // next sec
    t = 13; // todo vom RTC holen
    
    if( s == 60 ) { s = 0; m++; m_skip=true; } else m_skip = false;
    if( m == 60 ) { m=0; h++; h_skip=true; } else h_skip = false;
    if( h == 24 ) { h=0; m=0; s=0; d_skip = true;}

    if( m_skip ) showTemperature();
    if( d_skip ) showDate();
    
    showTime();
    delay(675);
}

void showDate() {
    tft.setFont(&FreeSerif12pt7b);
    deleteMsg( 350,50,1, D );
    deleteMsg( 350,75,1, "Montag" );

    D = D;  // muss von RTC geholt werden
    showmsgXY( 350,50, 1, D );
    showmsgXY( 350,75,1, "Montag" );
}

void showTemperature() {
    tft.setFont(&FreeSerif12pt7b);
    deleteMsg( 50,50,1, T );
    T = String(t);
    showmsgXY( 50,50, 1, T + " °C" );
}
void showTime() {
    Serial.println( "TFT.setFont: FreeSevenSegNumFont" );
    tft.setFont(&FreeSevenSegNumFont);

    // clean screen from old message 
    deleteMsg( 300, 180, 1, S );
    if( m_skip ) deleteMsg( 220, 180, 1, M );
    if( h_skip ) deleteMsg( 140, 180, 1, H );
    
    buildTimeStrings();
    showmsgXY(300, 180, 1, S );
    if( m_skip) showmsgXY(220, 180, 1, M );
    if( h_skip) showmsgXY(140, 180, 1, H );

}

void showmsgXY(int x, int y, int sz, String msg)
{
    tft.setCursor(x, y);
    tft.setTextSize(sz);
    tft.println(msg);
}

void deleteMsg( int x, int y, int sz, String msg ) {
    int16_t x1, y1;
    uint16_t w, h;
    // this calculates the rectangle used by this String
    tft.getTextBounds(msg, x, y, &x1, &y1, &w, &h);
    tft.fillRect(x1, y1, w, h, WHITE );
}


void buildTimeStrings() {
    // build String for SEC
    
    if( s < 10 ) S = "0"; else S = "";
    S += String( s );

    // build String for MIN
    if( m < 10 ) M = "0"; else M ="";
    M += String(m);
    
    // build String for hour, display only when changed or 1stTime
    if( h < 10 ) H = "0"; else H = "";
    H+= String(h);
}
